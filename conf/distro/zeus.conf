## conf/distro/zeus.conf
```bitbake
require conf/distro/poky.conf

DISTRO = "zeus"
DISTRO_NAME = "Zeus"
DISTRO_VERSION = "0.1.0"

MAINTAINER = "Tamás Soós <tsoos99@gmail.com>"

TARGET_VENDOR = "-zeus"

SKIP_META_RAUC_FEATURE_CHECK = "1"

INIT_MANAGER = "systemd"
VIRTUAL-RUNTIME_syslog = ""
VIRTUAL-RUNTIME_base-utils-syslog = ""

DISTRO_FEATURES:remove = "bluetooth 3g opengl wayland x11 nfc nfs ext2 irda zeroconf alsa pcmcia wifi pulseaudio vulkan"
```

## conf/layer.conf
```bitbake
# We have a conf and classes directory, add to BBPATH
BBPATH .= ":${LAYERDIR}"

# We have recipes-* directories, add to BBFILES
BBFILES += "${LAYERDIR}/recipes-*/*/*.bb \
            ${LAYERDIR}/recipes-*/*/*.bbappend"

BBFILE_COLLECTIONS += "meta-zeus"
BBFILE_PATTERN_meta-zeus = "^${LAYERDIR}/"
BBFILE_PRIORITY_meta-zeus = "6"

LAYERDEPENDS_meta-zeus = "core phytec"
LAYERSERIES_COMPAT_meta-zeus = "scarthgap"
```
